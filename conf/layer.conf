## conf/layer.conf
```bitbake
# We have a conf and classes directory, add to BBPATH
BBPATH .= ":${LAYERDIR}"

# We have recipes-* directories, add to BBFILES
BBFILES += "${LAYERDIR}/recipes-*/*/*.bb ${LAYERDIR}/recipes-*/*/*.bbappend"

BBFILE_COLLECTIONS += "autoipc"
BBFILE_PATTERN_autoipc = "^${LAYERDIR}/"
BBFILE_PRIORITY_autoipc = "5"

# This should only be incremented on significant changes that will
# cause compatibility issues with other layers
LAYERVERSION_autoipc = "1"
LAYERDEPENDS_autoipc = "core"
LAYERSERIES_COMPAT_autoipc = "scarthgap"
```
